## conf/layer.conf
```bitbake
# We have a conf and classes directory, add to BBPATH
BBPATH .= ":${LAYERDIR}"

# We have recipes-* directories, add to BBFILES
BBFILES += "${LAYERDIR}/recipes-*/*/*.bb \
            ${LAYERDIR}/recipes-*/*/*.bbappend"

BBFILE_COLLECTIONS += "meta-bsp-jr"
BBFILE_PATTERN_meta-bsp-jr = "^${LAYERDIR}/"
BBFILE_PRIORITY_meta-bsp-jr = "6"

LAYERDEPENDS_meta-bsp-jr = "core"
LAYERSERIES_COMPAT_meta-bsp-jr = "kirkstone"
```
